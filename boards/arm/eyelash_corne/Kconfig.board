## boards/arm/eyelash_corne/Kconfig.board
```kconfig
#
# Copyright (c) 2024 The ZMK Contributors
# SPDX-License-Identifier: MIT
#

config BOARD_EYELASH_CORNE_LEFT
    bool "eyelash_corne left"
    depends on SOC_NRF52840_QIAA

config BOARD_EYELASH_CORNE_RIGHT
    bool "eyelash_corne right"
    depends on SOC_NRF52840_QIAA


config BOARD_EYELASH_CORNE_PERIPHERAL_LEFT
    bool "eyelash_corne left peripheral"
    depends on SOC_NRF52840_QIAA

config BOARD_EYELASH_CORNE_PERIPHERAL_RIGHT
    bool "eyelash_corne right peripheral"
    depends on SOC_NRF52840_QIAA
```

## boards/shields/eyelash_corne_dongle/Kconfig.defconfig
```kconfig
# Copyright (c) 2024 The ZMK Contributors
# SPDX-License-Identifier: MIT

if SHIELD_EYELASH_CORNE_DONGLE

config ZMK_KEYBOARD_NAME
    default "Eyelash Corne"

config ZMK_SPLIT
    default y

config ZMK_SPLIT_ROLE_CENTRAL
    default y

config ZMK_SPLIT_BLE_CENTRAL_PERIPHERALS
    default 2

if ZMK_DISPLAY

config I2C
    default y

config SH1106
    default y

choice ZMK_DISPLAY_WORK_QUEUE
    default ZMK_DISPLAY_WORK_QUEUE_DEDICATED
endchoice

endif # ZMK_DISPLAY

if SH1106

config LV_Z_VDB_SIZE
    default 64

config LV_DPI_DEF
    default 148

config LV_Z_BITS_PER_PIXEL
    default 1

choice LV_COLOR_DEPTH
    default LV_COLOR_DEPTH_1
endchoice

endif # SH1106

endif # SHIELD_EYELASH_CORNE_DONGLE
```

## boards/shields/eyelash_corne_dongle/Kconfig.shield
```kconfig
# Copyright (c) 2026
# SPDX-License-Identifier: MIT

config SHIELD_EYELASH_CORNE_CENTRAL_DONGLE
    def_bool $(shields_list_contains,eyelash_corne_central_dongle)
```

## config/west.yml
```yaml
manifest:
  defaults:
    revision: v0.3
  remotes:
    - name: zmkfirmware
      url-base: https://github.com/zmkfirmware
    - name: gpeye
      url-base: https://github.com/GPeye
    - name: tokyo2006
      url-base: https://github.com/tokyo2006
    - name: englmaxi
      url-base: https://github.com/englmaxi
    - name: mctechnology17
      url-base: https://github.com/mctechnology17
    # Additional modules containing boards/shields/custom code can be listed here as well
    # See https://docs.zephyrproject.org/3.2.0/develop/west/manifest.html#projects
  projects:
    - name: zmk
      remote: zmkfirmware
      revision: v0.3.0
      import: app/west.yml
    - name: zmk-dongle-display
      remote: englmaxi
      revision: v0.3.0
    - name: zmk-nice-oled
      remote: mctechnology17
      revision: main
    - name: hammerbeam-slideshow          #new entry
      remote: gpeye                       #new entry
      revision: main                      #new entry
  self:
    path: config
```
